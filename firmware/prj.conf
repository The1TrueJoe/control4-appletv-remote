## CMakeLists.txt
```
cmake_minimum_required(VERSION 3.20.0)

# The siri_remote module (fetched by west into modules/siri-remote/zephyr).
set(ZEPHYR_EXTRA_MODULES ${CMAKE_CURRENT_SOURCE_DIR}/../modules/siri-remote/zephyr)

find_package(Zephyr REQUIRED HINTS $ENV{ZEPHYR_BASE})
project(siri_bridge)

target_sources(app PRIVATE
  src/main.c
  src/config.c
  src/wifi_prov.c
  src/mdns_adv.c
  src/webui.c
  src/forwarder.c
  src/voice.c
)
```

## Kconfig
```
mainmenu "Siri Remote -> Control4 bridge"

config SIRI_BRIDGE_TRANSCODE
	bool "Transcode A1513 Speex -> Opus on-device"
	default n
	help
	  The A1513 remote sends Speex; appled wants Opus, so the bridge must
	  transcode. This is the heaviest task on the MCU (Opus encode, no FPU
	  on the C6 - borderline). Enable only on an ESP32-S3 (FPU, dual core)
	  and after benchmarking. When off, voice is relayed only for Opus-native
	  A1962 remotes and A1513 voice is dropped with a warning.

config SIRI_BRIDGE_AP_SSID
	string "Provisioning SoftAP SSID prefix"
	default "SiriBridge"

source "Kconfig.zephyr"
```

## west.yml
```
# West manifest for the ESP32 Siri Remote -> Control4 bridge firmware.
# `west init -l firmware && west update` fetches Zephyr + the siri_remote module.
manifest:
  remotes:
    - name: zephyrproject
      url-base: https://github.com/zephyrproject-rtos
    - name: the1truejoe
      url-base: https://github.com/The1TrueJoe
  projects:
    - name: zephyr
      remote: zephyrproject
      revision: main           # pin to a release tag before shipping
      import: true
    - name: hal_espressif
      remote: zephyrproject
      revision: HEAD
      path: modules/hal/espressif
      groups: [hal]
    - name: siri-remote
      remote: the1truejoe
      revision: main           # the siri_remote Zephyr module lives in zephyr/
      path: modules/siri-remote
  self:
    path: application
```

## prj.conf
```kconfig
# Siri Remote -> Control4 bridge firmware (ESP32-S3, Zephyr).

CONFIG_LOG=y
CONFIG_SIRI_REMOTE=y

# --- Bluetooth LE central (the remote side) ---
CONFIG_BT=y
CONFIG_BT_CENTRAL=y
CONFIG_BT_GATT_CLIENT=y
CONFIG_BT_SMP=y
CONFIG_BT_BONDABLE=y
CONFIG_BT_SETTINGS=y
# Hold a whole 101-byte notification (PROTOCOL.md §7).
CONFIG_BT_L2CAP_RX_MTU=110
CONFIG_BT_BUF_ACL_RX_SIZE=120
CONFIG_BT_BUF_ACL_RX_COUNT_EXTRA=6

# --- WiFi (the Control4 side) ---
CONFIG_WIFI=y
CONFIG_NET_L2_WIFI_MGMT=y
CONFIG_WIFI_NM=y
# SoftAP for first-boot provisioning + STA for normal operation.
CONFIG_NET_IPV4=y
CONFIG_NET_DHCPV4=y
CONFIG_NET_DHCPV4_SERVER=y   # serve the provisioning AP
CONFIG_NET_TCP=y
CONFIG_NET_SOCKETS=y
CONFIG_DNS_RESOLVER=y

# --- mDNS advertise + HTTP server (web UI / status / discovery) ---
CONFIG_MDNS_RESPONDER=y
CONFIG_MDNS_RESPONDER_DNS_SD=y   # DNS-SD service advertising
CONFIG_HTTP_SERVER=y
CONFIG_HTTP_PARSER=y
CONFIG_HTTP_CLIENT=y             # POST commands to the Control4 target

# --- persistent settings (WiFi creds, room, target, button map) ---
CONFIG_SETTINGS=y
CONFIG_SETTINGS_NVS=y
CONFIG_NVS=y
CONFIG_FLASH=y
CONFIG_FLASH_MAP=y

# --- audio (voice) ---
# A1962 relays Opus with no codec. A1513 needs Speex->Opus (heavy); gated off
# by default until benchmarked on an S3 - see Kconfig SIRI_BRIDGE_TRANSCODE.

CONFIG_MAIN_STACK_SIZE=8192
CONFIG_SYSTEM_WORKQUEUE_STACK_SIZE=4096
CONFIG_HEAP_MEM_POOL_SIZE=65536
CONFIG_NET_BUF_DATA_SIZE=256
```

## boards/esp32s3_devkitm.conf
```kconfig
# Espressif ESP32-S3-DevKitM. Same S3 SoC as the XIAO; transcode viable.
CONFIG_ESP_SPIRAM=y
CONFIG_SIRI_BRIDGE_TRANSCODE=y
```

## boards/xiao_esp32s3.conf
```kconfig
# Seeed XIAO ESP32-S3: FPU + dual core + PSRAM. The target for on-device
# Speex->Opus transcode (A1513 voice).
CONFIG_ESP_SPIRAM=y
CONFIG_SIRI_BRIDGE_TRANSCODE=y
```

## src/main.c
```c
/*
 * Siri Remote -> Control4 bridge firmware (ESP32-S3, Zephyr).
 *
 * Boot flow: load config -> bring up WiFi (STA, or provisioning AP) -> start
 * the web UI -> once on the network, advertise over mDNS and start the BLE
 * central. Remote buttons/swipes are POSTed to the Control4 target; Siri voice
 * goes to appled. The module (siri_remote) owns all BLE/protocol detail.
 */
#include <zephyr/kernel.h>
#include <zephyr/logging/log.h>
#include <zephyr/settings/settings.h>

#include <siri_remote.h>

#include "config.h"
#include "forwarder.h"
#include "mdns_adv.h"
#include "voice.h"
#include "webui.h"
#include "wifi_prov.h"

LOG_MODULE_REGISTER(main, LOG_LEVEL_INF);

/* --- remote event callbacks: fan out to forwarder + voice --- */

static void on_button(uint8_t mask, bool down)
{
	/* SIRI is the voice path (handled by on_voice_*); everything else maps
	 * to a Control4 command. */
	if (mask != SIRI_BTN_SIRI) {
		forwarder_button(mask, down);
	}
}

static void on_swipe(enum siri_swipe dir)
{
	static const char *n[] = {"SWIPE_UP", "SWIPE_DOWN", "SWIPE_LEFT", "SWIPE_RIGHT"};
	forwarder_swipe(n[dir]);
}

static void on_voice_start(void) { voice_start(); }
static void on_voice_frame(enum siri_codec c, const uint8_t *d, size_t n)
{
	voice_frame(c, d, n);
}
static void on_voice_end(const struct siri_voice_stats *st)
{
	ARG_UNUSED(st);
	voice_end();
}
static void on_connected(uint16_t mtu, enum siri_model model)
{
	LOG_INF("remote connected (mtu %u, model %d)", mtu, model);
}

static const struct siri_remote_cb remote_cb = {
	.on_connected = on_connected,
	.on_button = on_button,
	.on_swipe = on_swipe,
	.on_voice_start = on_voice_start,
	.on_voice_frame = on_voice_frame,
	.on_voice_end = on_voice_end,
};

int main(void)
{
	settings_subsys_init();
	settings_load();
	bridge_config_load(NULL);
	struct bridge_config *cfg = bridge_config();

	webui_start(); /* available on both AP (provisioning) and STA */

	bool online = wifi_prov_start();
	if (!online) {
		LOG_WRN("not on the network yet - finish provisioning at the AP");
		return 0; /* stay up serving the provisioning form */
	}

	mdns_adv_start(WEBUI_PORT);

	if (cfg->remote_addr[0]) {
		struct siri_remote_config rc = {
			.address = cfg->remote_addr,
			.addr_public = true,
			.cb = &remote_cb,
		};
		int err = siri_remote_start(&rc);
		if (err) {
			LOG_ERR("siri_remote_start: %d", err);
		}
	} else {
		LOG_WRN("no remote address configured yet (set it in the web UI)");
	}
	return 0;
}
```

## src/config.c
```c
#include "config.h"

#include <zephyr/settings/settings.h>
#include <zephyr/logging/log.h>
#include <string.h>

LOG_MODULE_REGISTER(bridge_config, LOG_LEVEL_INF);

static struct bridge_config g_cfg;

/* One settings key holding the whole struct - simple and atomic enough here. */
#define CFG_KEY "bridge/cfg"

static int cfg_set(const char *name, size_t len, settings_read_cb read_cb, void *cb_arg)
{
	if (settings_name_next(name, NULL) == 0) {
		ssize_t n = read_cb(cb_arg, &g_cfg, sizeof(g_cfg));
		if (n < 0) {
			return (int)n;
		}
	}
	return 0;
}

SETTINGS_STATIC_HANDLER_DEFINE(bridge, "bridge", NULL, cfg_set, NULL, NULL);

void bridge_config_load(struct bridge_config *out)
{
	memset(&g_cfg, 0, sizeof(g_cfg));
	/* settings_subsys_init()/settings_load() are called once in main. */
	settings_load_subtree("bridge");
	if (out) {
		*out = g_cfg;
	}
}

int bridge_config_save(const struct bridge_config *cfg)
{
	if (cfg && cfg != &g_cfg) {
		g_cfg = *cfg;
	}
	return settings_save_one(CFG_KEY, &g_cfg, sizeof(g_cfg));
}

struct bridge_config *bridge_config(void)
{
	return &g_cfg;
}
```

## src/config.h
```c
/*
 * Persistent bridge configuration (NVS via the settings subsystem):
 * WiFi creds, the Control4 target, the room, and button-map overrides.
 */
#ifndef BRIDGE_CONFIG_H_
#define BRIDGE_CONFIG_H_

#include <stdbool.h>
#include <stdint.h>

#define CFG_STR 64

struct bridge_config {
	char wifi_ssid[CFG_STR];
	char wifi_psk[CFG_STR];
	/* Control4 target base URL, e.g. "http://10.0.0.20:5080" (webhook) or the
	 * native driver's listen URL. Command API per docs/FORWARDER.md. */
	char target_url[128];
	char target_pass[CFG_STR]; /* optional Bearer/X-API-Key */
	char room[CFG_STR];        /* room id/name; empty = let the target infer */
	char remote_addr[32];      /* the Siri Remote BD address */
	bool provisioned;          /* true once WiFi creds are stored */
};

/* Load from NVS (settings). Fills defaults if unset. */
void bridge_config_load(struct bridge_config *out);

/* Persist the whole config. */
int bridge_config_save(const struct bridge_config *cfg);

/* The live, in-RAM config (loaded at boot). */
struct bridge_config *bridge_config(void);

#endif /* BRIDGE_CONFIG_H_ */
```

## src/forwarder.c
```c
/*
 * Forwarder: remote control -> Control4 command, POSTed to the target per
 * docs/FORWARDER.md. Default map matches siri-c4d's config.rs defaults.
 *
 * UNVERIFIED: Zephyr's HTTP client API (http_client_req / struct
 * http_request) field names vary by version; the POST helper is written to
 * that shape but review on your release.
 */
#include "forwarder.h"
#include "config.h"

#include <siri_remote.h> /* SIRI_BTN_* */

#include <zephyr/kernel.h>
#include <zephyr/logging/log.h>
#include <zephyr/net/http/client.h>
#include <zephyr/net/socket.h>
#include <stdio.h>
#include <string.h>

LOG_MODULE_REGISTER(forwarder, LOG_LEVEL_INF);

struct mapping {
	uint8_t mask;
	const char *path;    /* "/command" or "/preset" ... */
	const char *press;   /* command/body on press */
	const char *release; /* command on release (hold), or NULL */
};

/* Default button map (docs/FORWARDER.md). Hold entries set release. */
static const struct mapping BTN_MAP[] = {
	{SIRI_BTN_MENU,       "/command", "MENU", NULL},
	{SIRI_BTN_PLAY_PAUSE, "/command", "PLAYPAUSE", NULL},
	{SIRI_BTN_VOL_UP,     "/command", "START_VOL_UP", "STOP_VOL_UP"},
	{SIRI_BTN_VOL_DOWN,   "/command", "START_VOL_DOWN", "STOP_VOL_DOWN"},
	{SIRI_BTN_TOUCHPAD,   "/command", "ENTER", NULL},
	{SIRI_BTN_TOUCHPAD_2, "/command", "BACK", NULL},
	{SIRI_BTN_AIRPLAY,    "/command", "ROOM_OFF", NULL},
	/* SIRI handled by the voice path, not here. */
};

/* Fire one command: POST {"command":CMD[,"room":ROOM]} to target_url+path. */
static void post_command(const char *path, const char *command)
{
	struct bridge_config *cfg = bridge_config();
	if (!cfg->target_url[0]) {
		LOG_WRN("no Control4 target configured");
		return;
	}
	char body[128];
	if (cfg->room[0]) {
		snprintf(body, sizeof(body),
			 "{\"command\":\"%s\",\"room\":\"%s\"}", command, cfg->room);
	} else {
		snprintf(body, sizeof(body), "{\"command\":\"%s\"}", command);
	}

	/* TODO: parse target_url into host/port once; connect; http_client_req.
	 * Sketch of the Zephyr HTTP client call: */
	LOG_INF("POST %s%s %s", cfg->target_url, path, body);
	/*
	 * int sock = connect_to(cfg->target_url);
	 * struct http_request req = {
	 *     .method = HTTP_POST, .url = path, .host = host,
	 *     .protocol = "HTTP/1.1", .payload = body, .payload_len = strlen(body),
	 *     .header_fields = (const char *[]){
	 *         "Content-Type: application/json\r\n",
	 *         cfg->target_pass[0] ? bearer_header(cfg->target_pass) : NULL, NULL },
	 *     .response = resp_cb, .recv_buf = buf, .recv_buf_len = sizeof(buf),
	 * };
	 * http_client_req(sock, &req, 2000, NULL);
	 * close(sock);
	 */
}

void forwarder_button(uint8_t mask, bool down)
{
	for (size_t i = 0; i < ARRAY_SIZE(BTN_MAP); i++) {
		if (BTN_MAP[i].mask != mask) {
			continue;
		}
		if (down) {
			post_command(BTN_MAP[i].path, BTN_MAP[i].press);
		} else if (BTN_MAP[i].release) {
			post_command(BTN_MAP[i].path, BTN_MAP[i].release);
		}
		return;
	}
}

void forwarder_swipe(const char *swipe_name)
{
	/* SWIPE_UP/DOWN/LEFT/RIGHT -> UP/DOWN/LEFT/RIGHT (docs/FORWARDER.md). */
	const char *cmd = swipe_name + 6; /* skip "SWIPE_" */
	post_command("/command", cmd);
}
```

## src/forwarder.h
```c
/* Map remote controls to Control4 commands and POST them to the target. */
#ifndef BRIDGE_FORWARDER_H_
#define BRIDGE_FORWARDER_H_

#include <stdbool.h>
#include <stdint.h>

/* A control fired by the remote (button bit or swipe name). `down` is the edge
 * (true=press). The forwarder applies the default map (docs/FORWARDER.md),
 * resolving hold-style actions on press/release, and POSTs to the configured
 * Control4 target. */
void forwarder_button(uint8_t mask, bool down);
void forwarder_swipe(const char *swipe_name); /* "SWIPE_UP" etc. */

#endif /* BRIDGE_FORWARDER_H_ */
```

## src/mdns_adv.c
```c
/*
 * mDNS / DNS-SD advertising of the bridge.
 *
 * UNVERIFIED: Zephyr's DNS-SD registration (DNS_SD_REGISTER_TCP_SERVICE) takes
 * a STATIC instance/txt at build time, while our TXT (room, id, model) is
 * runtime config. Options at integration: (a) register with a fixed instance
 * and minimal TXT and let the driver read room/model from the bridge's HTTP
 * /health, or (b) use a Zephyr version with runtime DNS-SD record APIs.
 * This file takes option (a): advertise name+port+path via DNS-SD; the driver
 * fetches the rest over HTTP. TXT keys still documented in docs/FORWARDER.md.
 */
#include "mdns_adv.h"
#include "config.h"

#include <zephyr/kernel.h>
#include <zephyr/logging/log.h>
#include <zephyr/net/dns_sd.h>
#include <stdint.h>

LOG_MODULE_REGISTER(mdns_adv, LOG_LEVEL_INF);

/* Port is advertised via this variable (DNS-SD reads &port). The HTTP port is
 * fixed at build for the macro; keep it in sync with webui.c (80). */
static uint16_t g_port = 80;

/* Minimal TXT: the driver reads room/model/id from HTTP /health. */
DNS_SD_REGISTER_TCP_SERVICE(bridge_sd, CONFIG_NET_HOSTNAME, "_appletv-bridge",
			    "local", DNS_SD_EMPTY_TXT, &g_port);

void mdns_adv_start(uint16_t http_port)
{
	g_port = http_port;
	LOG_INF("advertising _appletv-bridge._tcp on port %u", http_port);
	/* The DNS-SD responder runs via CONFIG_MDNS_RESPONDER; nothing else to
	 * do here beyond keeping g_port current. */
}
```

## src/mdns_adv.h
```c
/* Advertise _appletv-bridge._tcp over mDNS so the Control4 driver finds us. */
#ifndef BRIDGE_MDNS_ADV_H_
#define BRIDGE_MDNS_ADV_H_

/* Register the service on the given port with TXT per docs/FORWARDER.md. */
void mdns_adv_start(uint16_t http_port);

#endif /* BRIDGE_MDNS_ADV_H_ */
```

## src/voice.c
```c
/*
 * Voice relay to Control4 appled over c4vc.
 *
 * The c4vc BINARY framing below is fully specified in
 * docs/c4-voice-path/PROTOCOL.md and implemented here. What is NOT yet wired
 * (flagged TODO) because it is unproven live and/or heavy:
 *   - The appled :9200 JSON setup (remote -> activate -> button down) that
 *     opens the dynamic c4vc port. Needs the live garage bring-up first.
 *   - A1513 Speex -> Opus transcode (CONFIG_SIRI_BRIDGE_TRANSCODE): appled only
 *     accepts Opus. A1962 relays Opus verbatim (this file's happy path).
 */
#include "voice.h"
#include "config.h"

#include <zephyr/kernel.h>
#include <zephyr/logging/log.h>
#include <zephyr/net/socket.h>
#include <string.h>

LOG_MODULE_REGISTER(voice, LOG_LEVEL_INF);

#define C4VC_PORT_DEFAULT 9201 /* opened dynamically by appled; see PROTOCOL.md */

static int g_sock = -1;
static uint32_t g_stream_id;

/* ---- c4vc binary framing (docs/c4-voice-path/PROTOCOL.md §1,4,6) ---- */

static void put_be16(uint8_t *p, uint16_t v) { p[0] = v >> 8; p[1] = v; }
static void put_be32(uint8_t *p, uint32_t v)
{
	p[0] = v >> 24; p[1] = v >> 16; p[2] = v >> 8; p[3] = v;
}

/* 12-byte handshake: "C4VC" | ver=1 | rsvd=0 | stream_id(!=0), all big-endian. */
static int c4vc_handshake(int sock, uint32_t id)
{
	uint8_t hs[12] = {'C', '4', 'V', 'C'};
	put_be16(&hs[4], 1);
	put_be16(&hs[6], 0);
	put_be32(&hs[8], id);
	if (zsock_send(sock, hs, sizeof(hs), 0) != (ssize_t)sizeof(hs)) {
		return -EIO;
	}
	uint8_t reply[12];
	ssize_t n = zsock_recv(sock, reply, sizeof(reply), 0);
	if (n != (ssize_t)sizeof(reply) || memcmp(reply, "C4VC", 4) != 0) {
		return -EPROTO;
	}
	uint32_t echoed = ((uint32_t)reply[8] << 24) | ((uint32_t)reply[9] << 16) |
			  ((uint32_t)reply[10] << 8) | reply[11];
	return (echoed == id) ? 0 : -EACCES; /* appled zeroes the id to reject */
}

/* Audio packet: 0x01 | 0x00 | len(be16)=12+N | ms(be32) | rms(f64 be) | opus. */
static int c4vc_send_opus(int sock, const uint8_t *opus, size_t n, uint32_t ms, double db)
{
	uint8_t hdr[16] = {0x01, 0x00};
	put_be16(&hdr[2], (uint16_t)(12 + n));
	put_be32(&hdr[4], ms);
	uint64_t bits;
	memcpy(&bits, &db, sizeof(bits)); /* IEEE-754; appled reads big-endian */
	for (int i = 0; i < 8; i++) {
		hdr[8 + i] = (uint8_t)(bits >> (56 - 8 * i));
	}
	if (zsock_send(sock, hdr, sizeof(hdr), 0) != (ssize_t)sizeof(hdr)) {
		return -EIO;
	}
	return (zsock_send(sock, opus, n, 0) == (ssize_t)n) ? 0 : -EIO;
}

/* Finish: 0x02 | success | 0x00 0x00. */
static void c4vc_finish(int sock, bool ok)
{
	uint8_t f[4] = {0x02, ok ? 1 : 0, 0, 0};
	(void)zsock_send(sock, f, sizeof(f), 0);
}

/* ---- public ---- */

void voice_start(void)
{
	/* TODO: speak appled :9200 JSON (remote/activate/button down) to open the
	 * c4vc port, then connect it here. Gated on the live bring-up. */
	g_stream_id = (uint32_t)(sys_rand32_get() | 1);
	LOG_INF("voice start (c4vc stream id %u) - appled session setup TODO", g_stream_id);
	g_sock = -1; /* not opened until the :9200 setup lands */
}

void voice_frame(enum siri_codec codec, const uint8_t *data, size_t len)
{
	if (codec == SIRI_CODEC_SPEEX) {
#ifdef CONFIG_SIRI_BRIDGE_TRANSCODE
		/* TODO: libspeex decode -> libopus encode (16 kHz mono), then send
		 * the Opus. Heavy; S3 only. */
		LOG_WRN("A1513 Speex transcode not yet implemented");
#else
		LOG_WRN("A1513 Speex dropped (enable SIRI_BRIDGE_TRANSCODE on an S3)");
#endif
		return;
	}
	/* A1962: relay Opus verbatim. */
	if (g_sock >= 0) {
		(void)c4vc_send_opus(g_sock, data, len, 20 /*ms*/, -40.0 /*db est*/);
	}
}

void voice_end(void)
{
	if (g_sock >= 0) {
		c4vc_finish(g_sock, true);
		zsock_close(g_sock);
		g_sock = -1;
	}
}
```

## src/voice.h
```c
/* Voice path: relay the remote's audio to Control4 appled (c4vc). */
#ifndef BRIDGE_VOICE_H_
#define BRIDGE_VOICE_H_

#include <siri_remote.h> /* enum siri_codec */
#include <stddef.h>
#include <stdint.h>

void voice_start(void);
void voice_frame(enum siri_codec codec, const uint8_t *data, size_t len);
void voice_end(void);

#endif /* BRIDGE_VOICE_H_ */
```

## src/webui.c
```c
/*
 * HTTP server for provisioning + config + health.
 *
 * UNVERIFIED: Zephyr's HTTP server API (HTTP_SERVICE_DEFINE / HTTP_RESOURCE_*
 * and the http_resource_detail_dynamic handler signature) changed across
 * versions. This is written to the current (http_server) shape; adjust the
 * handler prototype to your Zephyr release. The HTML is intentionally tiny.
 */
#include "webui.h"
#include "config.h"

#include <zephyr/kernel.h>
#include <zephyr/logging/log.h>
#include <zephyr/net/http/server.h>
#include <zephyr/net/http/service.h>
#include <stdio.h>
#include <string.h>

LOG_MODULE_REGISTER(webui, LOG_LEVEL_INF);

static uint16_t http_port = WEBUI_PORT;
HTTP_SERVICE_DEFINE(bridge_http, "0.0.0.0", &http_port, 1, 4, NULL, NULL);

static const char PAGE[] =
	"<!doctype html><meta name=viewport content='width=device-width'>"
	"<title>Siri Bridge</title><h2>Siri Remote Bridge</h2>"
	"<form method=post action=/save>"
	"WiFi SSID <input name=ssid><br>"
	"WiFi password <input name=psk type=password><br>"
	"Control4 URL <input name=url placeholder='http://10.0.0.20:5080'><br>"
	"Control4 password <input name=pass type=password><br>"
	"Room <input name=room placeholder='Living Room'><br>"
	"Remote address <input name=remote placeholder='DC:2B:2A:..'><br>"
	"<button>Save &amp; reboot</button></form>";

/* GET / : the config form. */
static int page_handler(struct http_client_ctx *client, enum http_data_status status,
			const struct http_request_ctx *req, struct http_response_ctx *resp,
			void *user)
{
	ARG_UNUSED(client); ARG_UNUSED(status); ARG_UNUSED(req); ARG_UNUSED(user);
	resp->body = (const uint8_t *)PAGE;
	resp->body_len = sizeof(PAGE) - 1;
	resp->final_chunk = true;
	return 0;
}
static struct http_resource_detail_dynamic page_detail = {
	.common = { .type = HTTP_RESOURCE_TYPE_DYNAMIC,
		    .bitmask_of_supported_http_methods = BIT(HTTP_GET) },
	.cb = page_handler,
};
HTTP_RESOURCE_DEFINE(page_rsrc, bridge_http, "/", &page_detail);

/* GET /health : JSON the Control4 driver reads (room/model/id). */
static int health_handler(struct http_client_ctx *client, enum http_data_status status,
			  const struct http_request_ctx *req, struct http_response_ctx *resp,
			  void *user)
{
	ARG_UNUSED(client); ARG_UNUSED(status); ARG_UNUSED(req); ARG_UNUSED(user);
	static char json[192];
	struct bridge_config *cfg = bridge_config();
	int n = snprintf(json, sizeof(json),
			 "{\"ok\":true,\"name\":\"%s\",\"room\":\"%s\",\"model\":\"a1513\"}",
			 CONFIG_NET_HOSTNAME, cfg->room);
	resp->body = (const uint8_t *)json;
	resp->body_len = n;
	resp->final_chunk = true;
	return 0;
}
static struct http_resource_detail_dynamic health_detail = {
	.common = { .type = HTTP_RESOURCE_TYPE_DYNAMIC,
		    .bitmask_of_supported_http_methods = BIT(HTTP_GET) },
	.cb = health_handler,
};
HTTP_RESOURCE_DEFINE(health_rsrc, bridge_http, "/health", &health_detail);

/* POST /save : parse form fields, persist, reboot. (Parsing TODO.) */
static int save_handler(struct http_client_ctx *client, enum http_data_status status,
			const struct http_request_ctx *req, struct http_response_ctx *resp,
			void *user)
{
	ARG_UNUSED(client); ARG_UNUSED(user);
	/* TODO: accumulate req->data across chunks, urldecode the form fields
	 * (ssid/psk/url/pass/room/remote) into bridge_config(), save, then
	 * sys_reboot(SYS_REBOOT_COLD). */
	if (status == HTTP_SERVER_DATA_FINAL) {
		struct bridge_config *cfg = bridge_config();
		cfg->provisioned = true;
		bridge_config_save(cfg);
		static const char ok[] = "saved; rebooting";
		resp->body = (const uint8_t *)ok;
		resp->body_len = sizeof(ok) - 1;
		resp->final_chunk = true;
		LOG_INF("config saved via web UI");
		/* sys_reboot(SYS_REBOOT_COLD);  // enable once parsing is done */
	}
	return 0;
}
static struct http_resource_detail_dynamic save_detail = {
	.common = { .type = HTTP_RESOURCE_TYPE_DYNAMIC,
		    .bitmask_of_supported_http_methods = BIT(HTTP_POST) },
	.cb = save_handler,
};
HTTP_RESOURCE_DEFINE(save_rsrc, bridge_http, "/save", &save_detail);

void webui_start(void)
{
	http_port = WEBUI_PORT;
	int err = http_server_start();
	if (err) {
		LOG_ERR("http_server_start: %d", err);
	} else {
		LOG_INF("web UI on http://0.0.0.0:%u/", WEBUI_PORT);
	}
}
```

## src/webui.h
```c
/* Tiny HTTP server: provisioning form, config, and /health. */
#ifndef BRIDGE_WEBUI_H_
#define BRIDGE_WEBUI_H_

#include <stdint.h>

#define WEBUI_PORT 80

/* Start the HTTP server. Serves the config/provisioning page, POST /save, and
 * GET /health (JSON the Control4 driver reads for room/model/id). */
void webui_start(void);

#endif /* BRIDGE_WEBUI_H_ */
```

## src/wifi_prov.c
```c
/*
 * WiFi provisioning for the bridge.
 *
 * UNVERIFIED (no board/SDK here): the exact Zephyr WiFi mgmt API shape varies
 * by version. This uses net_mgmt(NET_REQUEST_WIFI_CONNECT / ..._AP_ENABLE)
 * with struct wifi_connect_req_params; adjust field names to your Zephyr
 * release. The captive form is served by webui.c on the AP interface.
 */
#include "wifi_prov.h"
#include "config.h"

#include <zephyr/kernel.h>
#include <zephyr/logging/log.h>
#include <zephyr/net/net_if.h>
#include <zephyr/net/net_mgmt.h>
#include <zephyr/net/wifi_mgmt.h>
#include <string.h>

LOG_MODULE_REGISTER(wifi_prov, LOG_LEVEL_INF);

static bool g_connected;
static bool g_ap;
static struct net_mgmt_event_callback g_cb;

static void wifi_evt(struct net_mgmt_event_callback *cb, uint32_t evt,
		     struct net_if *iface)
{
	ARG_UNUSED(cb);
	ARG_UNUSED(iface);
	switch (evt) {
	case NET_EVENT_WIFI_CONNECT_RESULT:
		g_connected = true;
		LOG_INF("WiFi connected");
		break;
	case NET_EVENT_WIFI_DISCONNECT_RESULT:
		g_connected = false;
		LOG_WRN("WiFi disconnected");
		break;
	default:
		break;
	}
}

static int sta_connect(const struct bridge_config *cfg)
{
	struct net_if *iface = net_if_get_default();
	struct wifi_connect_req_params p = {0};
	p.ssid = (const uint8_t *)cfg->wifi_ssid;
	p.ssid_length = strlen(cfg->wifi_ssid);
	p.psk = (const uint8_t *)cfg->wifi_psk;
	p.psk_length = strlen(cfg->wifi_psk);
	p.security = p.psk_length ? WIFI_SECURITY_TYPE_PSK : WIFI_SECURITY_TYPE_NONE;
	p.channel = WIFI_CHANNEL_ANY;
	p.band = WIFI_FREQ_BAND_2_4_GHZ;
	return net_mgmt(NET_REQUEST_WIFI_CONNECT, iface, &p, sizeof(p));
}

static int ap_start(void)
{
	struct net_if *iface = net_if_get_default();
	struct wifi_connect_req_params p = {0};
	/* SSID: SiriBridge-XXXX (append part of the MAC in a real build). */
	static char ssid[32];
	snprintk(ssid, sizeof(ssid), "%s-setup", CONFIG_SIRI_BRIDGE_AP_SSID);
	p.ssid = (const uint8_t *)ssid;
	p.ssid_length = strlen(ssid);
	p.security = WIFI_SECURITY_TYPE_NONE; /* open; the form is on 192.168.x.1 */
	p.channel = 1;
	p.band = WIFI_FREQ_BAND_2_4_GHZ;
	g_ap = true;
	LOG_INF("provisioning AP '%s' up; browse http://192.168.4.1/", ssid);
	/* TODO: NET_REQUEST_WIFI_AP_ENABLE signature differs across versions. */
	return net_mgmt(NET_REQUEST_WIFI_AP_ENABLE, iface, &p, sizeof(p));
}

bool wifi_prov_start(void)
{
	net_mgmt_init_event_callback(&g_cb, wifi_evt,
				     NET_EVENT_WIFI_CONNECT_RESULT |
					     NET_EVENT_WIFI_DISCONNECT_RESULT);
	net_mgmt_add_event_callback(&g_cb);

	struct bridge_config *cfg = bridge_config();
	if (cfg->provisioned && cfg->wifi_ssid[0]) {
		if (sta_connect(cfg) == 0) {
			/* Wait briefly for association. */
			for (int i = 0; i < 100 && !g_connected; i++) {
				k_msleep(100);
			}
			if (g_connected) {
				return true;
			}
		}
		LOG_WRN("STA connect failed; falling back to provisioning AP");
	}
	ap_start();
	return false;
}

bool wifi_prov_connected(void)
{
	return g_connected;
}

bool wifi_prov_ap_active(void)
{
	return g_ap;
}
```

## src/wifi_prov.h
```c
/*
 * WiFi bring-up: connect with stored creds, or start a SoftAP + captive form
 * for first-boot provisioning.
 */
#ifndef BRIDGE_WIFI_PROV_H_
#define BRIDGE_WIFI_PROV_H_

#include <stdbool.h>

/* If provisioned, join the stored network (STA). Otherwise (or on repeated
 * STA failure) start the provisioning SoftAP. Returns true if STA connected. */
bool wifi_prov_start(void);

/* True once associated to the configured network with an IP. */
bool wifi_prov_connected(void);

/* True while the provisioning SoftAP is up. */
bool wifi_prov_ap_active(void);

#endif /* BRIDGE_WIFI_PROV_H_ */
```
